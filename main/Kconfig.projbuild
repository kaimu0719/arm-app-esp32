## main/Kconfig.projbuild
```kconfig
# このファイルは「プロジェクト独自の設定項目」を menuconfig に追加する。
# IDF が main/Kconfig.projbuild を自動で拾い、menuconfig のメニューに表示する。
# ここで定義した項目は sdkconfig に保存され（gitignore済み＝gitに載らない）、
# C からは CONFIG_<名前> で参照できる。

menu "WiFi Configuration"

    config WIFI_SSID
        string "WiFi SSID"
        default ""
        help
            接続先の WiFi ネットワーク名（SSID）。※ESP32 は 2.4GHz のみ対応。

    config WIFI_PASSWORD
        string "WiFi Password"
        default ""
        help
            WiFi パスワード（WPA/WPA2）。

endmenu
```

## sdkconfig.defaults
```kconfig
CONFIG_ESP_MAIN_TASK_STACK_SIZE=32768

# 実機のフラッシュは4MB。既定の2MBのままだと起動毎に警告が出る＆全容量を使えない。
# （選択肢型の設定なので、使いたい選択肢 _4MB を y にする）
CONFIG_ESPTOOLPY_FLASHSIZE_4MB=y

# 自作の partitions.csv を使う（storage 区画を足すため）。
# これが無いと IDF 既定の3区画テーブルが使われ、partitions.csv は無視される。
CONFIG_PARTITION_TABLE_CUSTOM=y
CONFIG_PARTITION_TABLE_CUSTOM_FILENAME="partitions.csv"
```
